/**************************************************************************************************
  Filename:       bsp_ruby_lum.c
  Revised:        $Date: 2015/9/10 $
  Revision:       $Revision: 1 $

  Description:    This file contains the interface to the bsp ruby capacity measurement.

  Copyright 2015 - 2016 QijiTek. All rights reserved.
**************************************************************************************************/

/***************************************************************************************************
 *                                             INCLUDES
 ***************************************************************************************************/
#include "hal_mcu.h"
#include "hal_defs.h"
#include "hal_types.h"
#include "hal_drivers.h"
#include "osal.h"
#include "hal_board.h"
#include "hal_i2c.h"
#include "bsp_ruby_lum.h"
#include "hal_adc.h"

/***************************************************************************************************
 *                                             CONSTANTS
 ***************************************************************************************************/

/***************************************************************************************************
 *                                              MACROS
 ***************************************************************************************************/

/***************************************************************************************************
 *                                              TYPEDEFS
 ***************************************************************************************************/


/***************************************************************************************************
 *                                           GLOBAL VARIABLES
 ***************************************************************************************************/

/***************************************************************************************************
 *                                            LOCAL FUNCTION
 ***************************************************************************************************/

/***************************************************************************************************
 *                                            FUNCTIONS - API
 ***************************************************************************************************/
/***************************************************************************************************
 * @fn      BspRubyLumInit
 *
 * @brief   Initialize Comparator
 *
 * @param   None
 *          
 *          
 *                    
 *
 * @return  None
 ***************************************************************************************************/
void BspRubyLumInit()
{
  BSP_LUMEN_APCFG |= 0x07;
  OPAMPMC = 0x03;
  OPAMPC |= 0x03;
  while(OPAMPS);
}

/***************************************************************************************************
* @fn      BspRubyLumMeas
*
* @brief   Initialize Comparator
*
* @param   None
*          
* @return  None
***************************************************************************************************/
uint16 BspRubyLumMeas()
{
  uint16 result=0;
  float vdd=0;
  
  BSP_LUMEN_APCFG |= 0x07;
  OPAMPMC = 0x03;
  OPAMPC |= 0x03;
  while(OPAMPS);
  
  HalAdcSetReference(HAL_ADC_REF_125V);
  result = HalAdcRead(HAL_ADC_CHN_AIN2,HAL_ADC_RESOLUTION_14);
  
  if(result>8190){
    vdd = 3*HalAdcRead(HAL_ADC_CHN_VDD3,HAL_ADC_RESOLUTION_14)/8192;
    HalAdcSetReference(HAL_ADC_REF_AVDD);
    result = (uint16)(HalAdcRead(HAL_ADC_CHN_AIN2,HAL_ADC_RESOLUTION_14)*vdd);
  }
  return result;
}
/***************************************************************************************************
***************************************************************************************************/




